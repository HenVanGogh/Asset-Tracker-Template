## app/src/modules/custom_mqtt/Kconfig.custom_mqtt
```kconfig
#
# Copyright (c) 2024 Nordic Semiconductor
#
# SPDX-License-Identifier: LicenseRef-Nordic-5-Clause
#

menuconfig APP_CUSTOM_MQTT
	bool "Custom MQTT module"
	default n
	help
	  Enable the custom MQTT module for connecting to t4as.org server.

if APP_CUSTOM_MQTT

config APP_CUSTOM_MQTT_SHELL
	bool "Enable custom MQTT shell"
	default y if SHELL
	help
	  Enable custom MQTT shell commands.

config APP_CUSTOM_MQTT_SEC_TAG
	int "Security tag for custom MQTT connection"
	default 12345
	help
	  The security tag that corresponds to the credentials (CA, client cert,
	  private key) provisioned in the modem for the custom MQTT broker.

config APP_CUSTOM_MQTT_PAYLOAD_BUFFER_MAX_SIZE
	int "Payload maximum buffer size"
	default 512
	help
	  Maximum size of the buffer sent over MQTT to the custom server.

config APP_CUSTOM_MQTT_THREAD_STACK_SIZE
	int "Thread stack size for custom MQTT module"
	default 2048
	help
	  Stack size for the custom MQTT module thread.

config APP_CUSTOM_MQTT_BROKER_HOSTNAME
	string "MQTT broker hostname"
	default "49fc73a33de54e32966eac3525e9106c.s1.eu.hivemq.cloud"
	help
	  Hostname of the MQTT broker to connect to.

config APP_CUSTOM_MQTT_BROKER_PORT
	int "MQTT broker port"
	default 8883
	help
	  Port number of the MQTT broker (8883 for TLS, 1883 for non-TLS).

config APP_CUSTOM_MQTT_USERNAME
	string "MQTT username"
	default "hivemq.webclient.1755608677668"
	help
	  Username for MQTT broker authentication.

config APP_CUSTOM_MQTT_PASSWORD
	string "MQTT password"
	default "I.a$,MC0%bPJ9fdegO82"
	help
	  Password for MQTT broker authentication.

config APP_CUSTOM_MQTT_PUBLISH_TOPIC
	string "MQTT publish topic"
	default "devices/data/up"
	help
	  MQTT topic for publishing device data.

config APP_CUSTOM_MQTT_SUBSCRIBE_TOPIC
	string "MQTT subscribe topic"
	default "devices/command/down"
	help
	  MQTT topic for receiving commands from server.

config APP_CUSTOM_MQTT_KEEPALIVE_SECONDS
	int "MQTT keepalive interval in seconds"
	default 60
	help
	  MQTT keepalive interval in seconds.

config APP_CUSTOM_MQTT_MESSAGE_QUEUE_SIZE
	int "Message queue size for custom MQTT module"
	default 10
	help
	  Size of the message queue for the custom MQTT module.

module = APP_CUSTOM_MQTT
module-str = APP_CUSTOM_MQTT
source "subsys/logging/Kconfig.template.log_config"

endif # APP_CUSTOM_MQTT
```
