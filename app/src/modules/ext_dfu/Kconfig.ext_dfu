## tests/module/ext_dfu/testcase.yaml
```yaml
tests:
  asset_tracker_template.fw.ext_dfu:
    platform_allow:
      - native_sim
      - native_sim/native/64
    integration_platforms:
      - native_sim
```
