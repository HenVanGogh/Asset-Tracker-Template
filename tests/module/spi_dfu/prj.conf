## CMakeLists.txt
```
#
# Copyright (c) 2025 Nordic Semiconductor ASA
#
# SPDX-License-Identifier: LicenseRef-Nordic-5-Clause
#

cmake_minimum_required(VERSION 3.20.0)

find_package(Zephyr REQUIRED HINTS $ENV{ZEPHYR_BASE})
project(spi_dfu_module_test)

set(ATT_DIR ../../..)

zephyr_include_directories(src)
test_runner_generate(src/spi_dfu_module_test.c)

target_sources(app
  PRIVATE
  src/spi_dfu_module_test.c
  src/stubs.c
  ${ATT_DIR}/app/src/modules/spi_dfu/spi_dfu.c
)

zephyr_include_directories(${ZEPHYR_BASE}/include/zephyr/)
zephyr_include_directories(${ZEPHYR_BASE}/subsys/testsuite/include)
zephyr_include_directories(${ATT_DIR}/app/src/common)
zephyr_include_directories(${ATT_DIR}/app/src/modules/spi_dfu)
zephyr_include_directories(${ATT_DIR}/app/src/modules/ext_dfu)
zephyr_include_directories(${ATT_DIR}/app/src/modules/uart_sensor)

target_link_options(app PRIVATE --whole-archive)

# spi_dfu.c uses vsnprintf without including <stdio.h> explicitly.
target_compile_options(app PRIVATE -include stdio.h)

target_compile_definitions(app PRIVATE
	-DCONFIG_APP_SPI_DFU_LOG_LEVEL=4
	-DPM_NRF5340_DFU_ID=1
	-DPM_NRF5340_DFU_SIZE=262144
	# uart_sensor.h char arrays need these from its header
	-DCONFIG_APP_UART_SENSOR_PROBE_ID_MAX_LEN=32
	-DCONFIG_APP_UART_SENSOR_PROBE_ID_MIN_LEN=6
	-DCONFIG_APP_UART_SENSOR_BATTERY_MIN_MV=2700
	-DCONFIG_APP_UART_SENSOR_BATTERY_MAX_MV=4200
	-DCONFIG_APP_UART_SENSOR_RX_BUFFER_SIZE=256
	-DCONFIG_APP_UART_SENSOR_LINE_BUFFER_SIZE=128
	-DCONFIG_APP_UART_SENSOR_MSG_QUEUE_SIZE=10
	-DCONFIG_APP_UART_SENSOR_THREAD_STACK_SIZE=2048
	-DCONFIG_APP_UART_SENSOR_THREAD_PRIORITY=5
	-DCONFIG_APP_UART_SENSOR_ZBUS_TIMEOUT_MS=1000
	-DCONFIG_APP_UART_SENSOR_PROCESSING_TIMEOUT_MS=5000
	-DCONFIG_APP_UART_SENSOR_PROTOCOL_VERSION=1
	-DCONFIG_APP_UART_SENSOR_MESSAGE_DELIMITER=10
	-DCONFIG_APP_UART_SENSOR_FIELD_SEPARATOR=44
	-DCONFIG_APP_UART_SENSOR_VALUE_SEPARATOR=58
	-DCONFIG_APP_UART_SENSOR_ESL_POLL_INTERVAL_SEC=60
	-DCONFIG_APP_UART_SENSOR_ESL_MAX_TAGS=10
)
```

## prj.conf
```kconfig
CONFIG_UNITY=y
CONFIG_LOG=y
CONFIG_LOG_MODE_IMMEDIATE=y
CONFIG_HEAP_MEM_POOL_SIZE=16384
CONFIG_NATIVE_SIM_SLOWDOWN_TO_REAL_TIME=n
CONFIG_FLASH=y
CONFIG_FLASH_MAP=n
CONFIG_CRC=y
CONFIG_TEST=y

CONFIG_MAIN_STACK_SIZE=4096
CONFIG_TEST_EXTRA_STACK_SIZE=4096
```

## src/fake_transport.h
```c
/*
 * Copyright (c) 2025 Nordic Semiconductor ASA
 * SPDX-License-Identifier: LicenseRef-Nordic-5-Clause
 *
 * Shared state between stubs.c and spi_dfu_module_test.c so the
 * performance test can assert against the fake transport's bookkeeping.
 */
#ifndef FAKE_TRANSPORT_H_
#define FAKE_TRANSPORT_H_

#include <stddef.h>
#include <stdint.h>
#include <stdbool.h>

struct fake_perf {
	uint64_t xfer_cycles;
	uint32_t xfer_calls;
	uint32_t smp_frames_in;
	uint32_t lock_calls;
	uint32_t unlock_calls;
};

struct fake_transport {
	/* Configuration — set before starting DFU. */
	size_t   image_size;
	size_t   chunk_size;            /* must match DFU_CHUNK_SIZE */
	uint32_t fail_after_upload_chunks; /* 0 = never */
	bool     reset_no_response;

	/* Bookkeeping — populated by the fake server. */
	size_t   upload_offset;
	uint32_t upload_chunks_seen;
	size_t   bytes_acknowledged;
	uint32_t image_list_requests;
	uint32_t image_test_requests;
	uint32_t reset_requests;
	uint32_t timeouts_injected;
};

extern struct fake_perf      g_perf;
extern struct fake_transport g_xport;

void spi_dfu_stubs_reset(void);
void fake_set_image_available(size_t size);

#endif /* FAKE_TRANSPORT_H_ */
```

## src/pm_config.h
```c
/*
 * Stub pm_config.h for spi_dfu unit tests.
 * Provides the partition-manager constants that spi_dfu.c references.
 * The real file is generated by the build system from pm_static_*.yml.
 */
#pragma once

/* Provided via CMake -D flags in the test's CMakeLists.txt */
/* PM_NRF5340_DFU_ID and PM_NRF5340_DFU_SIZE come from there. */

#ifndef PM_NRF5340_DFU_ID
#define PM_NRF5340_DFU_ID   1
#endif

#ifndef PM_NRF5340_DFU_SIZE
#define PM_NRF5340_DFU_SIZE (256 * 1024)
#endif
```

## src/spi_dfu_module_test.c
```c
/*
 * Copyright (c) 2025 Nordic Semiconductor ASA
 * SPDX-License-Identifier: LicenseRef-Nordic-5-Clause
 *
 * spi_dfu module test — argument validation, full end-to-end pipeline
 * walk-through with a fake SMP server, and a performance/diagnostic
 * test that prints a software-timing report at the end of the run.
 *
 * The performance test answers two questions:
 *   1. How many SPI xfer calls and how much wall time does spi_dfu need
 *      to push a typical-sized image (64 KiB)?
 *   2. Where is time spent? (Polling overhead vs. actual SMP exchanges.)
 *
 * The fake transport in stubs.c records every xfer + the cumulative
 * cycles spent inside the transport. spi_dfu's real timing is dominated
 * by k_msleep(DFU_POLL_INTERVAL_MS=10) waits for DRDY, but our fake
 * always reports DRDY active immediately, so the measured numbers
 * isolate spi_dfu's *software* cost from the real SPI bus latency.
 */

#include <unity.h>
#include <zephyr/kernel.h>
#include <zephyr/sys/printk.h>
#include <string.h>

#include "spi_dfu.h"
#include "fake_transport.h"

#define DFU_CHUNK_SIZE  256

/* ------------------------------------------------------------------ */
/* Helpers                                                            */
/* ------------------------------------------------------------------ */

static bool wait_for_state(enum spi_dfu_state want, int timeout_ms)
{
	int64_t deadline = k_uptime_get() + timeout_ms;
	struct spi_dfu_status st;

	while (k_uptime_get() < deadline) {
		if (spi_dfu_get_status(&st) == 0 && st.state == want) {
			return true;
		}
		k_msleep(5);
	}
	return false;
}

static bool wait_for_terminal_state(int timeout_ms)
{
	int64_t deadline = k_uptime_get() + timeout_ms;
	struct spi_dfu_status st;

	while (k_uptime_get() < deadline) {
		if (spi_dfu_get_status(&st) == 0 &&
		    (st.state == SPI_DFU_STATE_DONE ||
		     st.state == SPI_DFU_STATE_ERROR)) {
			return true;
		}
		k_msleep(5);
	}
	return false;
}

void setUp(void)
{
	/* Wait for any previous DFU to settle BEFORE resetting stubs.
	 * Calling spi_dfu_stubs_reset() while an upload is in flight
	 * clears fail_after_upload_chunks, causing the active thread
	 * to resume rather than cancelling — so it never reaches a terminal state. */
	int64_t deadline = k_uptime_get() + 32000;
	struct spi_dfu_status st;

	while (k_uptime_get() < deadline) {
		if (spi_dfu_get_status(&st) == 0 &&
		    (st.state == SPI_DFU_STATE_IDLE ||
		     st.state == SPI_DFU_STATE_DONE ||
		     st.state == SPI_DFU_STATE_ERROR)) {
			break;
		}
		k_msleep(10);
	}
	spi_dfu_stubs_reset();
}
void tearDown(void) {}

/* ------------------------------------------------------------------ */
/* Argument-validation tests                                          */
/* ------------------------------------------------------------------ */

void test_get_status_with_null_returns_error(void)
{
	TEST_ASSERT_LESS_THAN(0, spi_dfu_get_status(NULL));
}

void test_get_status_initial_state_is_idle_or_terminal(void)
{
	struct spi_dfu_status st;

	TEST_ASSERT_EQUAL(0, spi_dfu_get_status(&st));
	/* The DFU thread is global — earlier tests may have left it in
	 * DONE/ERROR. Either is acceptable as long as the call returns. */
	TEST_ASSERT_TRUE(st.state == SPI_DFU_STATE_IDLE ||
			 st.state == SPI_DFU_STATE_DONE ||
			 st.state == SPI_DFU_STATE_ERROR);
}

void test_cancel_when_idle_returns_error(void)
{
	int err = spi_dfu_cancel();

	TEST_ASSERT_LESS_THAN(0, err);
}

void test_start_without_firmware_returns_enoent(void)
{
	int err = spi_dfu_start_nrf5340();

	TEST_ASSERT_EQUAL(-ENOENT, err);
}

/* ------------------------------------------------------------------ */
/* End-to-end happy path: drives all four phases.                     */
/* ------------------------------------------------------------------ */
void test_full_pipeline_completes_done(void)
{
	const size_t img = 4 * DFU_CHUNK_SIZE; /* 1 KiB — 4 chunks */

	g_xport.image_size = img;
	g_xport.chunk_size = DFU_CHUNK_SIZE;
	g_xport.reset_no_response = true; /* match real device behaviour */
	fake_set_image_available(img);

	TEST_ASSERT_EQUAL(0, spi_dfu_start_nrf5340());
	TEST_ASSERT_TRUE(wait_for_terminal_state(10000));

	struct spi_dfu_status st;

	TEST_ASSERT_EQUAL(0, spi_dfu_get_status(&st));
	TEST_ASSERT_EQUAL_MESSAGE(SPI_DFU_STATE_DONE, st.state, st.error_msg);
	TEST_ASSERT_EQUAL(img, st.bytes_uploaded);
	TEST_ASSERT_EQUAL(img, st.image_size);
	TEST_ASSERT_EQUAL(100, st.progress_pct);
	TEST_ASSERT_EQUAL(4, g_xport.upload_chunks_seen);
	TEST_ASSERT_EQUAL(1, g_xport.image_list_requests);
	TEST_ASSERT_EQUAL(1, g_xport.image_test_requests);
	TEST_ASSERT_EQUAL(1, g_xport.reset_requests);
}

/* ------------------------------------------------------------------ */
/* Failure injection: at least one chunk succeeds before the stall.   */
/* ------------------------------------------------------------------ */
void test_upload_makes_partial_progress_then_stalls(void)
{
	const size_t img = 8 * DFU_CHUNK_SIZE;

	g_xport.image_size = img;
	g_xport.chunk_size = DFU_CHUNK_SIZE;
	g_xport.fail_after_upload_chunks = 2; /* 2 ok then stall */
	fake_set_image_available(img);

	(void)spi_dfu_start_nrf5340();

	(void)wait_for_state(SPI_DFU_STATE_UPLOADING, 1000);
	k_msleep(500);

	TEST_ASSERT_EQUAL(2, g_xport.upload_chunks_seen);
	TEST_ASSERT_GREATER_OR_EQUAL(1, g_xport.timeouts_injected);

	/* Don't wait the full 30s SMP timeout; cancellation lets the
	 * thread unwind quickly. */
	(void)spi_dfu_cancel();
	/* The cancel flag is only checked between chunks. The active SMP
	 * exchange has DFU_RETRY_COUNT(3) retries × DFU_SMP_TIMEOUT_MS(30s) =
	 * up to 90 simulated seconds before the thread reaches ERROR state.
	 * With CONFIG_NATIVE_SIM_SLOWDOWN_TO_REAL_TIME=n this is nearly free
	 * in wall-clock time, so we wait here to prevent EBUSY in the next test. */
	(void)wait_for_terminal_state(95000);
}

/* ------------------------------------------------------------------ */
/* Performance / diagnostic test.                                     */
/*                                                                    */
/* Drives a 64 KiB upload and prints a structured report:             */
/*   spi_dfu_perf <metric>=<value>                                    */
/* The user can grep the build log for "spi_dfu_perf" to extract a    */
/* baseline and watch for regressions.                                */
/* ------------------------------------------------------------------ */
void test_performance_report_64k_upload(void)
{
	const size_t img = 64 * 1024; /* 256 chunks */

	g_xport.image_size = img;
	g_xport.chunk_size = DFU_CHUNK_SIZE;
	g_xport.reset_no_response = true;
	fake_set_image_available(img);

	int64_t  t0   = k_uptime_get();
	uint64_t cyc0 = k_cycle_get_64();

	TEST_ASSERT_EQUAL(0, spi_dfu_start_nrf5340());
	TEST_ASSERT_TRUE_MESSAGE(wait_for_terminal_state(60000),
				 "DFU did not reach terminal state in 60s");

	int64_t  elapsed_ms = k_uptime_get() - t0;
	uint64_t cyc_total  = k_cycle_get_64() - cyc0;

	struct spi_dfu_status st;

	(void)spi_dfu_get_status(&st);
	TEST_ASSERT_EQUAL_MESSAGE(SPI_DFU_STATE_DONE, st.state, st.error_msg);

	uint32_t expected_chunks = (uint32_t)(img / DFU_CHUNK_SIZE);
	uint32_t throughput_kbps = elapsed_ms > 0
		? (uint32_t)((img * 8ULL) / (uint32_t)elapsed_ms)
		: 0;
	uint32_t avg_chunk_us = expected_chunks
		? (uint32_t)((elapsed_ms * 1000ULL) / expected_chunks)
		: 0;
	uint64_t xfer_us = k_cyc_to_us_floor64(g_perf.xfer_cycles);
	uint32_t avg_xfer_us = g_perf.xfer_calls
		? (uint32_t)(xfer_us / g_perf.xfer_calls) : 0;

	printk("\n");
	printk("================== spi_dfu performance report ==================\n");
	printk("spi_dfu_perf image_bytes=%u\n",          (unsigned int)img);
	printk("spi_dfu_perf chunks_expected=%u\n",      expected_chunks);
	printk("spi_dfu_perf chunks_acked=%u\n",         g_xport.upload_chunks_seen);
	printk("spi_dfu_perf duration_ms=%lld\n",        elapsed_ms);
	printk("spi_dfu_perf software_throughput_kbps=%u\n", throughput_kbps);
	printk("spi_dfu_perf avg_chunk_latency_us=%u\n", avg_chunk_us);
	printk("spi_dfu_perf spi_xfer_calls=%u\n",       g_perf.xfer_calls);
	printk("spi_dfu_perf smp_frames_sent=%u\n",      g_perf.smp_frames_in);
	printk("spi_dfu_perf bus_lock_count=%u\n",       g_perf.lock_calls);
	printk("spi_dfu_perf bus_unlock_count=%u\n",     g_perf.unlock_calls);
	printk("spi_dfu_perf transport_total_us=%u\n",   (unsigned int)xfer_us);
	printk("spi_dfu_perf transport_avg_us=%u\n",     avg_xfer_us);
	printk("spi_dfu_perf total_cpu_cycles=%llu\n",   cyc_total);
	printk("spi_dfu_perf retries_observed=%u\n",     g_xport.timeouts_injected);
	printk("=================================================================\n");

	/* Sanity assertions so the report can't silently become meaningless. */
	TEST_ASSERT_EQUAL(expected_chunks, g_xport.upload_chunks_seen);
	TEST_ASSERT_EQUAL(img, st.bytes_uploaded);
	TEST_ASSERT_EQUAL(0,   g_xport.timeouts_injected);
	TEST_ASSERT_GREATER_THAN(expected_chunks, g_perf.xfer_calls);

	/* Lock/unlock must be perfectly balanced — leaks would deadlock
	 * the bus in production. */
	TEST_ASSERT_EQUAL(g_perf.lock_calls, g_perf.unlock_calls);
}

extern int unity_main(void);

int main(void) { (void)unity_main(); return 0; }
```

## src/stubs.c
```c
/*
 * Copyright (c) 2025 Nordic Semiconductor ASA
 * SPDX-License-Identifier: LicenseRef-Nordic-5-Clause
 *
 * Fake SPI transport + ext_dfu + flash_area stubs for spi_dfu tests.
 *
 * The fake transport emulates an nRF5340 MCUboot SMP server well enough
 * for the spi_dfu module thread to drive a complete:
 *
 *     UPLOADING -> TESTING -> RESETTING -> DONE
 *
 * sequence. It also instruments per-call timing so the performance test
 * can compute throughput, average chunk latency, retry rate, etc.
 */

#include <zephyr/kernel.h>
#include <zephyr/storage/flash_map.h>
#include <zephyr/sys/crc.h>
#include <string.h>

#include "ext_dfu.h"
#include "fake_transport.h"

/* SPI frame layout — must match spi_dfu.c */
#define SPI_FRAME_SIZE   520
#define SPI_PAYLOAD_MAX  512
#define SPI_MAGIC        0xA5
#define SPI_OFF_MAGIC    0
#define SPI_OFF_TYPE     1
#define SPI_OFF_LEN_LO   2
#define SPI_OFF_LEN_HI   3
#define SPI_OFF_PAYLOAD  4
#define SPI_OFF_CRC      516

#define FRAME_SMP        0x06
#define FRAME_READ_REQ   0x04
#define FRAME_NOOP       0x05

#define SMP_HDR_SIZE     8
#define SMP_OP_WRITE     2
#define SMP_OP_READ      0
#define SMP_GROUP_OS     0
#define SMP_GROUP_IMG    1
#define SMP_CMD_IMG_STATE  0
#define SMP_CMD_IMG_UPLOAD 1
#define SMP_CMD_OS_RESET   5

/* ------------------------------------------------------------------ */
/* Public test-side state                                             */
/* ------------------------------------------------------------------ */
struct fake_perf      g_perf;
struct fake_transport g_xport;

static struct ext_dfu_status g_ext_status = {
	.state         = EXT_DFU_STATE_IDLE,
	.bytes_written = 0,
};

void fake_set_image_available(size_t size)
{
	g_ext_status.state         = EXT_DFU_STATE_DONE;
	g_ext_status.bytes_written = size;
}

void spi_dfu_stubs_reset(void)
{
	memset(&g_perf, 0, sizeof(g_perf));
	memset(&g_xport, 0, sizeof(g_xport));
	g_ext_status.state         = EXT_DFU_STATE_IDLE;
	g_ext_status.bytes_written = 0;
}

/* ------------------------------------------------------------------ */
/* ext_dfu stubs                                                      */
/* ------------------------------------------------------------------ */
int ext_dfu_get_status(enum ext_dfu_target target, struct ext_dfu_status *st)
{
	(void)target;
	if (!st) {
		return -EINVAL;
	}
	*st = g_ext_status;
	return 0;
}

int ext_dfu_start(enum ext_dfu_target t, const char *u, int s)
{
	(void)t; (void)u; (void)s; return 0;
}
int ext_dfu_cancel(void)                       { return -EALREADY; }
int ext_dfu_erase(enum ext_dfu_target t)       { (void)t; return 0; }

/* ------------------------------------------------------------------ */
/* flash_area stubs                                                   */
/* ------------------------------------------------------------------ */
static struct flash_area g_fake_fa = {
	.fa_id = 1, .fa_off = 0, .fa_size = 1024 * 1024,
};

int flash_area_open(uint8_t id, const struct flash_area **fa)
{
	(void)id; *fa = &g_fake_fa; return 0;
}
void flash_area_close(const struct flash_area *fa) { (void)fa; }

int flash_area_read(const struct flash_area *fa, off_t off,
		    void *dst, size_t len)
{
	(void)fa;
	uint8_t *d = dst;
	for (size_t i = 0; i < len; i++) {
		d[i] = (uint8_t)((off + i) & 0xFF);
	}
	return 0;
}

/* ------------------------------------------------------------------ */
/* Fake SPI transport                                                 */
/* ------------------------------------------------------------------ */
static uint8_t g_resp[SPI_FRAME_SIZE];
static bool    g_resp_pending;

static uint8_t crc8_frame(const uint8_t *buf, size_t len)
{
	return crc8(buf, len, 0x07, 0x00, false);
}

static void make_resp_frame(uint8_t type, const uint8_t *payload, uint16_t len)
{
	memset(g_resp, 0, SPI_FRAME_SIZE);
	g_resp[SPI_OFF_MAGIC]  = SPI_MAGIC;
	g_resp[SPI_OFF_TYPE]   = type;
	g_resp[SPI_OFF_LEN_LO] = (uint8_t)(len & 0xFF);
	g_resp[SPI_OFF_LEN_HI] = (uint8_t)(len >> 8);
	if (payload && len) {
		memcpy(&g_resp[SPI_OFF_PAYLOAD], payload, len);
	}
	g_resp[SPI_OFF_CRC] = crc8_frame(g_resp, SPI_OFF_CRC);
	g_resp_pending = true;
}

/* ---- minimal CBOR encoders (returns full head byte including major type) -- */
static int cbor_put_uint_full(uint8_t *buf, size_t max, uint8_t major,
			      uint32_t val)
{
	if (val < 24) {
		if (max < 1) return -1;
		buf[0] = (uint8_t)((major << 5) | val);
		return 1;
	}
	if (val <= 0xFF) {
		if (max < 2) return -1;
		buf[0] = (uint8_t)((major << 5) | 24);
		buf[1] = (uint8_t)val;
		return 2;
	}
	if (val <= 0xFFFF) {
		if (max < 3) return -1;
		buf[0] = (uint8_t)((major << 5) | 25);
		buf[1] = (uint8_t)(val >> 8);
		buf[2] = (uint8_t)(val & 0xFF);
		return 3;
	}
	if (max < 5) return -1;
	buf[0] = (uint8_t)((major << 5) | 26);
	buf[1] = (uint8_t)(val >> 24);
	buf[2] = (uint8_t)(val >> 16);
	buf[3] = (uint8_t)(val >> 8);
	buf[4] = (uint8_t)(val & 0xFF);
	return 5;
}

static int build_upload_rsp(uint8_t *buf, size_t max, uint32_t off)
{
	int pos = 0;

	if (max < 1) return -1;
	buf[pos++] = (5 << 5) | 2;            /* map(2) */
	if (max - pos < 4) return -1;
	buf[pos++] = (3 << 5) | 2;            /* tstr "rc" */
	buf[pos++] = 'r'; buf[pos++] = 'c';
	int n = cbor_put_uint_full(buf + pos, max - pos, 0, 0);
	if (n < 0) return -1;
	pos += n;
	if (max - pos < 5) return -1;
	buf[pos++] = (3 << 5) | 3;            /* tstr "off" */
	buf[pos++] = 'o'; buf[pos++] = 'f'; buf[pos++] = 'f';
	n = cbor_put_uint_full(buf + pos, max - pos, 0, off);
	if (n < 0) return -1;
	pos += n;
	return pos;
}

static int build_image_list_rsp(uint8_t *buf, size_t max)
{
	int pos = 0;
	const uint8_t fake_hash[32] = {
		0x11,0x22,0x33,0x44,0x55,0x66,0x77,0x88,
		0x99,0xAA,0xBB,0xCC,0xDD,0xEE,0xFF,0x00,
		0x11,0x22,0x33,0x44,0x55,0x66,0x77,0x88,
		0x99,0xAA,0xBB,0xCC,0xDD,0xEE,0xFF,0x00,
	};

	if (max < 64) return -1;
	buf[pos++] = (5 << 5) | 1;            /* map(1) */
	buf[pos++] = (3 << 5) | 6;            /* tstr "images" */
	memcpy(&buf[pos], "images", 6); pos += 6;
	buf[pos++] = (4 << 5) | 1;            /* array(1) */
	buf[pos++] = (5 << 5) | 2;            /* map(2) */
	buf[pos++] = (3 << 5) | 4;
	memcpy(&buf[pos], "slot", 4); pos += 4;
	buf[pos++] = (0 << 5) | 1;            /* uint 1 */
	buf[pos++] = (3 << 5) | 4;
	memcpy(&buf[pos], "hash", 4); pos += 4;
	buf[pos++] = (2 << 5) | 24;           /* bstr len byte */
	buf[pos++] = 32;
	memcpy(&buf[pos], fake_hash, 32); pos += 32;
	return pos;
}

static int build_simple_rc_rsp(uint8_t *buf, size_t max, int rc)
{
	int pos = 0;

	if (max < 6) return -1;
	buf[pos++] = (5 << 5) | 1;            /* map(1) */
	buf[pos++] = (3 << 5) | 2;
	buf[pos++] = 'r'; buf[pos++] = 'c';
	uint8_t major = (rc >= 0) ? 0 : 1;
	uint32_t val  = (rc >= 0) ? (uint32_t)rc : (uint32_t)(-1 - rc);
	int n = cbor_put_uint_full(buf + pos, max - pos, major, val);
	if (n < 0) return -1;
	pos += n;
	return pos;
}

static void handle_smp_request(const uint8_t *frame)
{
	uint16_t len = (uint16_t)frame[SPI_OFF_LEN_LO] |
		       ((uint16_t)frame[SPI_OFF_LEN_HI] << 8);

	if (len < SMP_HDR_SIZE || len > SPI_PAYLOAD_MAX) {
		return;
	}

	const uint8_t *smp = &frame[SPI_OFF_PAYLOAD];
	uint8_t  op    = smp[0] & 0x07;
	uint16_t group = ((uint16_t)smp[4] << 8) | smp[5];
	uint8_t  cmd   = smp[7];

	uint8_t  smp_resp[SPI_PAYLOAD_MAX];
	uint8_t  cbor_buf[SPI_PAYLOAD_MAX - SMP_HDR_SIZE];
	int      cbor_len = -1;

	if (group == SMP_GROUP_IMG && cmd == SMP_CMD_IMG_UPLOAD &&
	    op == SMP_OP_WRITE) {

		if (g_xport.fail_after_upload_chunks &&
		    g_xport.upload_chunks_seen >= g_xport.fail_after_upload_chunks) {
			g_xport.timeouts_injected++;
			g_resp_pending = false;
			return;
		}

		size_t remaining = (g_xport.image_size > g_xport.upload_offset)
			? g_xport.image_size - g_xport.upload_offset : 0;
		size_t advance = remaining > g_xport.chunk_size
				 ? g_xport.chunk_size : remaining;

		g_xport.upload_offset      += advance;
		g_xport.upload_chunks_seen += 1;
		g_xport.bytes_acknowledged += advance;

		cbor_len = build_upload_rsp(cbor_buf, sizeof(cbor_buf),
					    (uint32_t)g_xport.upload_offset);
	} else if (group == SMP_GROUP_IMG && cmd == SMP_CMD_IMG_STATE &&
		   op == SMP_OP_READ) {
		cbor_len = build_image_list_rsp(cbor_buf, sizeof(cbor_buf));
		g_xport.image_list_requests++;
	} else if (group == SMP_GROUP_IMG && cmd == SMP_CMD_IMG_STATE &&
		   op == SMP_OP_WRITE) {
		cbor_len = build_simple_rc_rsp(cbor_buf, sizeof(cbor_buf), 0);
		g_xport.image_test_requests++;
	} else if (group == SMP_GROUP_OS && cmd == SMP_CMD_OS_RESET) {
		g_xport.reset_requests++;
		if (g_xport.reset_no_response) {
			g_resp_pending = false;
			return;
		}
		cbor_len = build_simple_rc_rsp(cbor_buf, sizeof(cbor_buf), 0);
	} else {
		cbor_len = build_simple_rc_rsp(cbor_buf, sizeof(cbor_buf), -1);
	}

	if (cbor_len < 0) {
		g_resp_pending = false;
		return;
	}

	smp_resp[0] = ((op + 1) & 0x07) | (1 << 3);
	smp_resp[1] = 0x00;
	smp_resp[2] = (uint8_t)(cbor_len >> 8);
	smp_resp[3] = (uint8_t)(cbor_len & 0xFF);
	smp_resp[4] = (uint8_t)(group >> 8);
	smp_resp[5] = (uint8_t)(group & 0xFF);
	smp_resp[6] = smp[6];
	smp_resp[7] = cmd;
	memcpy(&smp_resp[SMP_HDR_SIZE], cbor_buf, cbor_len);

	make_resp_frame(FRAME_SMP, smp_resp,
			(uint16_t)(SMP_HDR_SIZE + cbor_len));
}

/* ---- transport API consumed by spi_dfu.c ---- */
int uart_sensor_spi_lock(k_timeout_t timeout)
{
	(void)timeout; g_perf.lock_calls++; return 0;
}
void uart_sensor_spi_unlock(void) { g_perf.unlock_calls++; }

int uart_sensor_spi_xfer_locked(const uint8_t *tx, uint8_t *rx)
{
	uint64_t t0 = k_cycle_get_64();

	g_perf.xfer_calls++;
	uint8_t type = tx[SPI_OFF_TYPE];

	if (type == FRAME_SMP) {
		g_perf.smp_frames_in++;
		handle_smp_request(tx);
	}

	if (g_resp_pending) {
		memcpy(rx, g_resp, SPI_FRAME_SIZE);
		if (type == FRAME_READ_REQ) {
			g_resp_pending = false;
		}
	} else {
		memset(rx, 0, SPI_FRAME_SIZE);
		rx[SPI_OFF_MAGIC] = SPI_MAGIC;
		rx[SPI_OFF_TYPE]  = FRAME_NOOP;
		rx[SPI_OFF_CRC]   = crc8_frame(rx, SPI_OFF_CRC);
	}

	g_perf.xfer_cycles += k_cycle_get_64() - t0;
	return 0;
}

bool uart_sensor_spi_drdy_active(void) { return g_resp_pending; }

int uart_sensor_spi_send_smp_fwd(const uint8_t *p, uint16_t len)
{
	(void)p; (void)len; return 0;
}

void uart_sensor_spi_submit_work(struct k_work *w) { (void)w; }
```
