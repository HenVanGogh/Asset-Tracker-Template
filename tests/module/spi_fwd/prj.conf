## CMakeLists.txt
```
#
# Copyright (c) 2025 Nordic Semiconductor ASA
#
# SPDX-License-Identifier: LicenseRef-Nordic-5-Clause
#

cmake_minimum_required(VERSION 3.20.0)

find_package(Zephyr REQUIRED HINTS $ENV{ZEPHYR_BASE})
project(spi_fwd_module_test)

set(ATT_DIR ../../..)

# Test source dir is added FIRST so our local stubs override real headers.
zephyr_include_directories(src)

test_runner_generate(src/spi_fwd_module_test.c)

target_sources(app
  PRIVATE
  src/spi_fwd_module_test.c
  src/stubs.c
  ${ATT_DIR}/app/src/modules/spi_fwd/spi_fwd.c
)

zephyr_include_directories(${ZEPHYR_BASE}/include/zephyr/)
zephyr_include_directories(${ZEPHYR_BASE}/subsys/testsuite/include)
zephyr_include_directories(${ZEPHYR_BASE}/../modules/lib/zcbor/include)
zephyr_include_directories(${ATT_DIR}/app/src/common)
zephyr_include_directories(${ATT_DIR}/app/src/modules/spi_fwd)
zephyr_include_directories(${ATT_DIR}/app/src/modules/uart_sensor)

target_link_options(app PRIVATE --whole-archive)

target_compile_definitions(app PRIVATE
	-DCONFIG_APP_SPI_FWD_LOG_LEVEL=4
	-DCONFIG_MCUMGR_SMP_CBOR_MAX_DECODING_LEVELS=3
	-DCONFIG_MCUMGR_SMP_CBOR_MAX_ENCODING_LEVELS=3
)
```

## prj.conf
```kconfig
CONFIG_UNITY=y
CONFIG_LOG=y
CONFIG_LOG_MODE_IMMEDIATE=y
CONFIG_HEAP_MEM_POOL_SIZE=8192
CONFIG_NATIVE_SIM_SLOWDOWN_TO_REAL_TIME=n
```

## src/spi_fwd_module_test.c
```c
/*
 * Copyright (c) 2025 Nordic Semiconductor ASA
 *
 * SPDX-License-Identifier: LicenseRef-Nordic-5-Clause
 */

#include <unity.h>
#include <zephyr/kernel.h>
#include <string.h>

#include "spi_fwd.h"

extern struct stub_state {
	unsigned int packet_alloc_count;
	unsigned int packet_free_count;
	unsigned int rx_req_count;
	unsigned int submit_work_count;
	unsigned int send_smp_fwd_count;
	uint8_t      last_rx_data[1024];
	uint16_t     last_rx_len;
	uint8_t      last_send_data[1024];
	uint16_t     last_send_len;
	int          send_smp_fwd_return;
	bool         alloc_returns_null;
} spi_fwd_stub;

extern void spi_fwd_stub_reset(void);

void setUp(void)
{
	spi_fwd_stub_reset();
}

void tearDown(void) {}

/* Happy path: an SMP request from the PC should be forwarded into MCUmgr
 * via smp_rx_req(), and the buffer contents must match the input.
 */
void test_spi_fwd_rx_forwards_into_mcumgr(void)
{
	uint8_t pkt[64];

	for (size_t i = 0; i < sizeof(pkt); i++) {
		pkt[i] = (uint8_t)i;
	}

	spi_fwd_rx(pkt, sizeof(pkt));

	TEST_ASSERT_EQUAL(1, spi_fwd_stub.packet_alloc_count);
	TEST_ASSERT_EQUAL(1, spi_fwd_stub.rx_req_count);
	TEST_ASSERT_EQUAL(sizeof(pkt), spi_fwd_stub.last_rx_len);
	TEST_ASSERT_EQUAL_MEMORY(pkt, spi_fwd_stub.last_rx_data, sizeof(pkt));
}

/* If smp_packet_alloc() fails, spi_fwd_rx() must drop the request without
 * calling smp_rx_req() and without leaking a packet.
 */
void test_spi_fwd_rx_drops_when_alloc_fails(void)
{
	uint8_t pkt[16] = {0};

	spi_fwd_stub.alloc_returns_null = true;
	spi_fwd_rx(pkt, sizeof(pkt));

	TEST_ASSERT_EQUAL(1, spi_fwd_stub.packet_alloc_count);
	TEST_ASSERT_EQUAL(0, spi_fwd_stub.rx_req_count);
	TEST_ASSERT_EQUAL(0, spi_fwd_stub.packet_free_count);
}

/* A request larger than the net_buf tailroom must be rejected and the
 * allocated packet freed.
 */
void test_spi_fwd_rx_rejects_oversize(void)
{
	static uint8_t big[2048];

	memset(big, 0xAA, sizeof(big));
	spi_fwd_rx(big, sizeof(big));

	TEST_ASSERT_EQUAL(1, spi_fwd_stub.packet_alloc_count);
	TEST_ASSERT_EQUAL(1, spi_fwd_stub.packet_free_count);
	TEST_ASSERT_EQUAL(0, spi_fwd_stub.rx_req_count);
}

extern int unity_main(void);

int main(void)
{
	(void)unity_main();
	return 0;
}
```

## src/stubs.c
```c
/*
 * Copyright (c) 2025 Nordic Semiconductor ASA
 *
 * SPDX-License-Identifier: LicenseRef-Nordic-5-Clause
 *
 * Stubs for MCUmgr SMP transport and net_buf functions used by spi_fwd.c.
 * Tracks calls so the test body can verify spi_fwd_rx() actually delivers
 * data into MCUmgr.
 */

#include <zephyr/kernel.h>
#include <zephyr/net_buf.h>
#include <string.h>

/* Test-visible state */
struct stub_state {
	unsigned int packet_alloc_count;
	unsigned int packet_free_count;
	unsigned int rx_req_count;
	unsigned int submit_work_count;
	unsigned int send_smp_fwd_count;
	uint8_t      last_rx_data[1024];
	uint16_t     last_rx_len;
	uint8_t      last_send_data[1024];
	uint16_t     last_send_len;
	int          send_smp_fwd_return;
	bool         alloc_returns_null;
};

struct stub_state spi_fwd_stub;

void spi_fwd_stub_reset(void)
{
	memset(&spi_fwd_stub, 0, sizeof(spi_fwd_stub));
}

/* ---- net_buf stub ----
 * spi_fwd.c uses smp_packet_alloc/free, which return a struct net_buf.
 * Provide a single static buf with a backing data area large enough
 * for a 512-byte SMP MTU.
 */
#define STUB_NB_DATA_SIZE 1024

static uint8_t  stub_nb_storage[STUB_NB_DATA_SIZE];
static struct net_buf stub_nb;

struct net_buf *smp_packet_alloc(void)
{
	spi_fwd_stub.packet_alloc_count++;
	if (spi_fwd_stub.alloc_returns_null) {
		return NULL;
	}
	memset(&stub_nb, 0, sizeof(stub_nb));
	stub_nb.data = stub_nb_storage;
	stub_nb.__buf = stub_nb_storage;
	stub_nb.size = STUB_NB_DATA_SIZE;
	stub_nb.len = 0;
	return &stub_nb;
}

void smp_packet_free(struct net_buf *nb)
{
	(void)nb;
	spi_fwd_stub.packet_free_count++;
}

/* spi_fwd.c declares smp_rx_req extern. Provide it. */
struct smp_transport;
void smp_rx_req(struct smp_transport *t, struct net_buf *nb)
{
	(void)t;
	spi_fwd_stub.rx_req_count++;
	if (nb && nb->len <= sizeof(spi_fwd_stub.last_rx_data)) {
		memcpy(spi_fwd_stub.last_rx_data, nb->data, nb->len);
		spi_fwd_stub.last_rx_len = nb->len;
	}
}

/* smp_transport_init — referenced by SYS_INIT. Return 0. */
int smp_transport_init(struct smp_transport *t)
{
	(void)t;
	return 0;
}

/* ---- uart_sensor stubs ---- */

void uart_sensor_spi_submit_work(struct k_work *work)
{
	spi_fwd_stub.submit_work_count++;
	if (work) {
		k_work_submit(work);
	}
}

int uart_sensor_spi_send_smp_fwd(const uint8_t *data, uint16_t len)
{
	spi_fwd_stub.send_smp_fwd_count++;
	if (len <= sizeof(spi_fwd_stub.last_send_data)) {
		memcpy(spi_fwd_stub.last_send_data, data, len);
		spi_fwd_stub.last_send_len = len;
	}
	return spi_fwd_stub.send_smp_fwd_return;
}

/* ---- net_buf_simple non-inline functions -------------------------------- */

void *net_buf_simple_add_mem(struct net_buf_simple *buf, const void *mem, size_t len)
{
	uint8_t *tail = buf->data + buf->len;

	buf->len += len;
	return memcpy(tail, mem, len);
}

size_t net_buf_simple_tailroom(const struct net_buf_simple *buf)
{
	return buf->size - (size_t)(buf->data - buf->__buf) - buf->len;
}
```

## src/uart_sensor.h
```c
/*
 * Copyright (c) 2025 Nordic Semiconductor ASA
 *
 * SPDX-License-Identifier: LicenseRef-Nordic-5-Clause
 *
 * Local stub for uart_sensor.h. spi_fwd.c only references two functions —
 * provide minimal declarations so the module compiles in isolation.
 */

#ifndef _UART_SENSOR_H_
#define _UART_SENSOR_H_

#include <zephyr/kernel.h>

void uart_sensor_spi_submit_work(struct k_work *work);
int  uart_sensor_spi_send_smp_fwd(const uint8_t *data, uint16_t len);

#endif /* _UART_SENSOR_H_ */
```
