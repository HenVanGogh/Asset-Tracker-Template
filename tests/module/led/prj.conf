## CMakeLists.txt
```
#
# Copyright (c) 2024 Nordic Semiconductor ASA
#
# SPDX-License-Identifier: LicenseRef-Nordic-5-Clause
#

cmake_minimum_required(VERSION 3.20.0)

find_package(Zephyr REQUIRED HINTS $ENV{ZEPHYR_BASE})
project(led_module_test)

set(ASSET_TRACKER_TEMPLATE_DIR ../../..)

test_runner_generate(src/led_module_test.c)

target_sources(app
  PRIVATE
  src/led_module_test.c
  src/redef.c
  ${ASSET_TRACKER_TEMPLATE_DIR}/app/src/modules/led/led.c
)

set_property(SOURCE ${ASSET_TRACKER_TEMPLATE_DIR}/app/src/modules/led/led.c PROPERTY COMPILE_FLAGS
             "-include ${CMAKE_CURRENT_SOURCE_DIR}/src/redef.h")

zephyr_include_directories(${ZEPHYR_BASE}/include/zephyr/)
zephyr_include_directories(${ZEPHYR_BASE}/subsys/testsuite/include)
zephyr_include_directories(../../../app/src/common)
zephyr_include_directories(../../../app/src/modules/led)

target_link_options(app PRIVATE --whole-archive)

# Force zbus.h included before runner sees led.h ZBUS_CHAN_DECLARE
target_compile_options(app PRIVATE -include zephyr/zbus/zbus.h)

target_compile_definitions(app PRIVATE
	-DCONFIG_APP_LED_LOG_LEVEL=4
)
```

## prj.conf
```kconfig
#
# Copyright (c) 2024 Nordic Semiconductor ASA
#
# SPDX-License-Identifier: LicenseRef-Nordic-5-Clause
#

CONFIG_UNITY=y
CONFIG_ZBUS=y
CONFIG_LOG=y
CONFIG_LOG_MODE_IMMEDIATE=y
CONFIG_ZBUS_OBSERVER_NAME=y
CONFIG_ZBUS_CHANNEL_NAME=y
CONFIG_ZBUS_MSG_SUBSCRIBER=y
CONFIG_ZBUS_RUNTIME_OBSERVERS=y
CONFIG_HEAP_MEM_POOL_SIZE=8192
CONFIG_NATIVE_SIM_SLOWDOWN_TO_REAL_TIME=n

# PWM is referenced via DT in led.c — provide a minimal fake.
CONFIG_PWM=n
```

## src/led_module_test.c
```c
/*
 * Copyright (c) 2025 Nordic Semiconductor ASA
 *
 * SPDX-License-Identifier: LicenseRef-Nordic-5-Clause
 */
#include <unity.h>
#include <zephyr/zbus/zbus.h>
#include <zephyr/logging/log.h>

#include "app_common.h"
#include "led.h"

LOG_MODULE_REGISTER(led_module_test, 4);

/* Test hooks defined in redef.c */
extern void fake_pwm_reset(void);
extern unsigned int fake_pwm_call_count(void);
extern int fake_pwm_set_return_value;

struct fake_pwm_call {
	const void *spec;
	uint32_t period;
	uint32_t pulse;
};
extern const struct fake_pwm_call *fake_pwm_last_three(void);

static int publish_led_msg(uint8_t r, uint8_t g, uint8_t b,
			   uint32_t on_ms, uint32_t off_ms, int reps)
{
	struct led_msg msg = {
		.type = LED_RGB_SET,
		.red = r,
		.green = g,
		.blue = b,
		.duration_on_msec = on_ms,
		.duration_off_msec = off_ms,
		.repetitions = reps,
	};
	return zbus_chan_pub(&LED_CHAN, &msg, K_SECONDS(1));
}

void setUp(void)
{
	fake_pwm_reset();
	/* Wait for SYS_INIT-driven module setup */
	k_sleep(K_MSEC(50));
}

void tearDown(void)
{
	/* Quiet the LED so leftover work items don't bleed into the next test */
	(void)publish_led_msg(0, 0, 0, 1000, 1000, 0);
	k_sleep(K_MSEC(50));
}

/* Steady-on (repetitions = -1, treated as forever) should program PWM with the
 * requested colour and not cycle off. We only require that the colour was
 * written exactly once.
 */
void test_steady_on_writes_colour_once(void)
{
	int err = publish_led_msg(255, 128, 64, 100, 100, -1);

	TEST_ASSERT_EQUAL(0, err);
	k_sleep(K_MSEC(50));

	const struct fake_pwm_call *last = fake_pwm_last_three();

	TEST_ASSERT_NOT_NULL(last);
	TEST_ASSERT_EQUAL_UINT32(255, last[0].pulse);
	TEST_ASSERT_EQUAL_UINT32(128, last[1].pulse);
	TEST_ASSERT_EQUAL_UINT32(64,  last[2].pulse);
}

/* repetitions = 0 should immediately turn the LED off (force_off path). */
void test_off_request_drives_zero_pulse(void)
{
	int err = publish_led_msg(255, 255, 255, 100, 100, 0);

	TEST_ASSERT_EQUAL(0, err);
	k_sleep(K_MSEC(50));

	const struct fake_pwm_call *last = fake_pwm_last_three();

	TEST_ASSERT_NOT_NULL(last);
	TEST_ASSERT_EQUAL_UINT32(0, last[0].pulse);
	TEST_ASSERT_EQUAL_UINT32(0, last[1].pulse);
	TEST_ASSERT_EQUAL_UINT32(0, last[2].pulse);
}

/* A finite-blink request should flip the LED multiple times until reps reach 0
 * and then stop scheduling further toggles. We verify by counting PWM writes.
 */
void test_finite_blink_completes(void)
{
	const int reps = 3;
	const uint32_t on_ms = 30;
	const uint32_t off_ms = 30;

	int err = publish_led_msg(10, 20, 30, on_ms, off_ms, reps);

	TEST_ASSERT_EQUAL(0, err);

	/* Run for long enough to complete all cycles plus margin. */
	k_sleep(K_MSEC((on_ms + off_ms) * (reps + 2)));

	unsigned int writes_during_blink = fake_pwm_call_count();

	/* Each toggle writes 3 PWM channels; expect at least one write per
	 * toggle. With reps=3 we expect ~7 transitions (initial on + 3 off + 3 on).
	 */
	TEST_ASSERT_GREATER_OR_EQUAL(3 * 4, writes_during_blink);

	/* Wait again — no further writes should happen. */
	unsigned int after_done = fake_pwm_call_count();

	k_sleep(K_MSEC((on_ms + off_ms) * 3));

	TEST_ASSERT_EQUAL(after_done, fake_pwm_call_count());
}

/* A new LED message should cancel the in-flight blink and replace it. */
void test_new_message_cancels_previous_blink(void)
{
	int err = publish_led_msg(255, 0, 0, 50, 50, -1);

	TEST_ASSERT_EQUAL(0, err);
	k_sleep(K_MSEC(120));

	unsigned int after_first = fake_pwm_call_count();

	/* Replace with a steady-off command */
	err = publish_led_msg(0, 0, 0, 1000, 1000, 0);
	TEST_ASSERT_EQUAL(0, err);

	k_sleep(K_MSEC(200));

	unsigned int after_replace = fake_pwm_call_count();

	/* The off command writes 3 PWM channels; nothing else should follow. */
	const struct fake_pwm_call *last = fake_pwm_last_three();

	TEST_ASSERT_NOT_NULL(last);
	TEST_ASSERT_EQUAL_UINT32(0, last[0].pulse);
	TEST_ASSERT_EQUAL_UINT32(0, last[1].pulse);
	TEST_ASSERT_EQUAL_UINT32(0, last[2].pulse);

	/* Sleep more — make sure no new toggles are scheduled */
	k_sleep(K_MSEC(300));
	TEST_ASSERT_EQUAL(after_replace, fake_pwm_call_count());

	(void)after_first;
}

extern int unity_main(void);

int main(void)
{
	(void)unity_main();
	return 0;
}
```

## src/redef.c
```c
/*
 * Copyright (c) 2025 Nordic Semiconductor ASA
 *
 * SPDX-License-Identifier: LicenseRef-Nordic-5-Clause
 */

#include <stdbool.h>
#include <stdint.h>
#include <stddef.h>

struct pwm_dt_spec; /* opaque to the test */

/* Capture last PWM call so the test can assert on the requested values. */
struct fake_pwm_call {
	const struct pwm_dt_spec *spec;
	uint32_t period;
	uint32_t pulse;
};

#define FAKE_PWM_HISTORY_LEN 32

static struct fake_pwm_call fake_pwm_history[FAKE_PWM_HISTORY_LEN];
static unsigned int fake_pwm_history_count;
int fake_pwm_set_return_value;

bool pwm_is_ready_dt(const struct pwm_dt_spec *spec)
{
	(void)spec;
	return true;
}

int pwm_set_dt(const struct pwm_dt_spec *spec, uint32_t period, uint32_t pulse)
{
	if (fake_pwm_history_count < FAKE_PWM_HISTORY_LEN) {
		fake_pwm_history[fake_pwm_history_count++] =
			(struct fake_pwm_call){ spec, period, pulse };
	}
	return fake_pwm_set_return_value;
}

void fake_pwm_reset(void)
{
	fake_pwm_history_count = 0;
	fake_pwm_set_return_value = 0;
}

unsigned int fake_pwm_call_count(void)
{
	return fake_pwm_history_count;
}

const struct fake_pwm_call *fake_pwm_last_three(void)
{
	if (fake_pwm_history_count < 3) {
		return NULL;
	}
	return &fake_pwm_history[fake_pwm_history_count - 3];
}
```

## src/redef.h
```c
/*
 * Copyright (c) 2025 Nordic Semiconductor ASA
 *
 * SPDX-License-Identifier: LicenseRef-Nordic-5-Clause
 */

#ifndef LED_REDEF_H_
#define LED_REDEF_H_

/* Prevent <zephyr/drivers/pwm.h> from being expanded so that we can supply
 * our own minimal stand-ins for the PWM API used by led.c. The real header
 * pulls in devicetree macros and inline functions that require board PWM
 * aliases (pwm_led0/1/2) which native_sim does not have.
 */
#define ZEPHYR_INCLUDE_DRIVERS_PWM_H_

#include <stdbool.h>
#include <stdint.h>
#include <zephyr/kernel.h>

struct pwm_dt_spec {
	const struct device *dev;
	uint32_t channel;
	uint32_t period;
	uint32_t flags;
};

#define PWM_USEC(x) (x)

/* Devicetree macros referenced in led.c — make them safe no-ops. */
#undef DT_ALIAS
#define DT_ALIAS(name) DT_INVALID_NODE
#undef DT_NODE_HAS_STATUS
#define DT_NODE_HAS_STATUS(node, status) 1
#undef PWM_DT_SPEC_GET
#define PWM_DT_SPEC_GET(node) ((struct pwm_dt_spec){ .dev = NULL })

bool pwm_is_ready_dt(const struct pwm_dt_spec *spec);
int  pwm_set_dt(const struct pwm_dt_spec *spec, uint32_t period, uint32_t pulse);

#endif /* LED_REDEF_H_ */
```
